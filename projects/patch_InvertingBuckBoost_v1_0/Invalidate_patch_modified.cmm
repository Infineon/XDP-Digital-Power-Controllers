print "running Shasta_invalidate_patch_Halim.cmm"

print "Step 1: RESET Target"
GO
WAIT 2s
SYSTEM.RESETTARGET
GO

print "Step 2: Invalidate partition 1 file 0x10"
; This file invalidates the first valid patch (id 0x10) in the partition.
LOCAL &addr
&otp_partition=1
&file_id=0x10

; Stop if running
BREAK
V os_running=0

R.S PC otp_fs_command_invalidate
R.S R0 &otp_partition
R.S R1 &file_id
B.S otp_fs_command_invalidate\11 /Program
GO
WAIT 2s
SYSTEM.RESETTARGET
GO


print "Step 3: Invalidate partition 0 file 0x06"
; This file invalidates the first valid patch (id 0x10) in the partition.
LOCAL &addr
&otp_partition=0
&file_id=0x06

; Stop if running
BREAK
V os_running=0

R.S PC otp_fs_command_invalidate
R.S R0 &otp_partition
R.S R1 &file_id
B.S otp_fs_command_invalidate\11 /Program
GO
WAIT 2s
SYSTEM.RESETTARGET
GO

print "Step 4: Invalidate partition 0 file 0x07"
; This file invalidates the first valid patch (id 0x10) in the partition.
LOCAL &addr
&otp_partition=0
&file_id=0x07

; Stop if running
BREAK
V os_running=0

R.S PC otp_fs_command_invalidate
R.S R0 &otp_partition
R.S R1 &file_id
B.S otp_fs_command_invalidate\11 /Program
GO
WAIT 2s
SYSTEM.RESETTARGET
GO

print "Step 5: Invalidate partition 0 file 0x08"
; This file invalidates the first valid patch (id 0x10) in the partition.
LOCAL &addr
&otp_partition=0
&file_id=0x08

; Stop if running
BREAK
V os_running=0

R.S PC otp_fs_command_invalidate
R.S R0 &otp_partition
R.S R1 &file_id
B.S otp_fs_command_invalidate\11 /Program
GO
WAIT 2s
SYSTEM.RESETTARGET
GO


print "Step 6: Invalidate partition 0 file 0x09"
; This file invalidates the first valid patch (id 0x10) in the partition.
LOCAL &addr
&otp_partition=0
&file_id=0x09

; Stop if running
BREAK
V os_running=0

R.S PC otp_fs_command_invalidate
R.S R0 &otp_partition
R.S R1 &file_id
B.S otp_fs_command_invalidate\11 /Program
GO
WAIT 2s
SYSTEM.RESETTARGET
GO

;print   "done ..."
