print "running Shasta_invalidate_patch.cmm"

; This file invalidates the first valid patch (id 0x10) in the partition.
LOCAL &addr
&otp_partition=1
&file_id=0x10

; Stop if running
BREAK
V os_running=0

R.S PC otp_fs_command_invalidate
R.S R0 &otp_partition
R.S R1 &file_id
B.S otp_fs_command_invalidate\11 /Program
GO
WAIT 1s
SYSTEM.RESETTARGET
GO

;print   "done ..."
