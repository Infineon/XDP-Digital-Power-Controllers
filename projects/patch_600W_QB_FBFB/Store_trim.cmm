; Script for storing a patch in OTP
; the correct rom needs to be loaded first
; because the script uses otp store functions from the rom

print "running Shasta_store_trim.cmm"
; set fw configuration data
V fw_trim_data.size = 42
V fw_trim_data.version = 2
; set Partition Table
var.set fw_trim_data.otp_sections[0].size = 0x4000
var.set fw_trim_data.otp_sections[1].size = 0xC000
var.set fw_trim_data.otp_sections[2].size = 0
var.set fw_trim_data.otp_sections[3].size = 0
var.set fw_trim_data.otp_sections[4].size = 0
var.set fw_trim_data.otp_sections[5].size = 0
var.set fw_trim_data.otp_sections[6].size = 0
var.set fw_trim_data.otp_sections[7].size = 0
var.set fw_trim_data.otp_sections[8].size = 0
var.set fw_trim_data.otp_sections[9].size = 0
var.set fw_trim_data.otp_sections[10].size = 0
var.set fw_trim_data.otp_sections[11].size = 0
var.set fw_trim_data.otp_sections[12].size = 0
var.set fw_trim_data.otp_sections[13].size = 0
var.set fw_trim_data.otp_sections[14].size = 0
var.set fw_trim_data.otp_sections[15].size = 0
var.set fw_trim_data.otp_sections[14].size = 0
var.set fw_trim_data.otp_sections[16].size = 0
; Partition 0 has a size of 0x4000
; Therefore make sure that the partition size is not exceeded
&otp_partition=0

V os_running=0

; Run command to store the patch to OTP and break at the end of the function
; Throw is not working in this context because it is not setup
R.S PC configurator_trim_registers_store
B.S configurator_trim_registers_store\22  /P
; Set a break point at the log_write to see if there was an error
B.S log_write
;B.S OTP_Write
GO
WAIT 1s

; Reset and restart the system
SYSTEM.RESETTARGET
DATA.DUMP 0x10020000--0x10022000

