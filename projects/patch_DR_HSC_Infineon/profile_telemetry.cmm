; profile examples of telemetry

; profile itsen_lpf
data.profile %WORD.DEFAULT 0x70005054

; profile itsen at 1ms update rate in firmware variable:
var.profile %HEX TELEM_DATA.temperature[2]

; how to use scratchpad data to plot assuming array of long/dwords
;data.Set 0x20061800 %long 0x00000001
;data.Set 0x20061804 %long 0x00000002
;data.Set 0x20061808 %long 0x00000003
data.draw %LONG.DEFAULT 0x20061800--0x20061808





