; This script needs to be run first in order to make the rom symbols available
print "running setup_fw.cmm"

; load the desired elf file ...

; in case you are debugging the naked device @ design step B11, you want to load the elf data WITHOUT loading the image into memory ==> /nocode

; load the ram image:

DATA.LOAD.ELF ".\build\patch\patch.elf" /NoCODE /NoRegister /NoClear /spath

do ".\load_rom_elf.cmm"

symbol.sourcepath.setrecursedir ..\..\

; loading the elf file changes the PC to the entry point that is
; stored in the elf file. But it does not reset the stack pointer to
; the value that is stored in the vector table. So we do this extra ..
register.init

; initialize RTOS support,
print "initializing RTX-ARM support..."
TASK.CONFIG "~~~~\..\..\tools\T32\Windows\rtx"                  ; load RTX-ARM awareness (rtx.t32)
MENU.ReProgram "~~~~\..\..\tools\T32\Windows\rtx"               ; load RTX-ARM menu (rtx.men)
HELP.FILTER.Add rtos_rtxarm                                     ; add RTX-ARM awareness manual to filtered help
print "load complete."

; and get me my latest arrangements of windows ...
do ~~~~\project_windows.cmm
;do ~~~~\dma_data.cmm

; clear pending interrupts - NVIC
D.S SD:0xE000E280 %LE %LONG 0xffffffff
; disable interrupt - NVIC
D.S SD:0xE000E180 %LE %LONG 0xffffffff
; clear execution pending interrupt - CORE
D.S SD:0xE000ED0C %LE %LONG 0x5fa0002
; Disable TICK interrupt
data.set 0xE000E010 %LONG 0x5
; Reset the remap bit
PER.Set.Field ED:0x40000000 %L 0x1 0

;b.s log_write


symbol.sourcepath.setrecursedir ..\..\

print   "done ..."
